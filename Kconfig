## Kconfig
```kconfig
mainmenu "RT-Thread Project Configuration"

config $BSP_DIR
    string
    option env="BSP_ROOT"
    default "."

config $RTT_DIR
    string
    option env="RTT_ROOT"
    default "rt-thread"

config $PKGS_DIR
    string
    option env="PKGS_ROOT"
    default "packages"

source "$RTT_DIR/KConfig"
source "$PKGS_DIR/KConfig"

config RT_USING_UART1
    bool "Enable UART1"
    default y

config RT_USING_UART2
    bool "Enable UART2"
    default y

config RT_USING_ESP_PSRAM
    bool "Enable SPI pSRAM"
    default n

if RT_USING_ESP_PSRAM
config RT_ESP_PSRAM_SIZE
    int "pSRAM size (KB)"
    default 4096
endif

config CONFIG_ESP_AUDIO
    bool "Enable ESP Audio feature, I2S"
    default n

config CONFIG_CHIP_ESP32
    bool
    default y

select CONFIG_CHIP_ESP32

choice CONFIG_BOARD
    prompt "Hardware board"
    default CONFIG_BOARD_ESP32
    help
        which hardware board should be this bsp supported.

config CONFIG_BOARD_ESP32
    bool "Espressif ESP32 board"
config CONFIG_BOARD_RTIOT_AUDIO
    bool "RT-IoT Audio board"
    select CONFIG_ESP_AUDIO
    select RT_USING_ESP_PSRAM
config CONFIG_BOARD_LYRAT
    bool "ESP32 LyraT board"
    select CONFIG_ESP_AUDIO
    select RT_USING_ESP_PSRAM

endchoice

config RT_USING_WIFI
    bool "Support WiFi"
    default y

config IDF_MBEDTLS
    bool "Enable mbedtls in IDF"
    default y

source "$BSP_DIR/components/Kconfig"
```

## esp-idf-port/Kconfig
```kconfig
menu "components in IDF of Espressif"

config IDF_MBEDTLS
    bool "Enable mbedtls in IDF"
    default y


config IDF_LWIP
    bool "Use lwIP inside IDF"
    default n

endmenu
```

## rt-thread/components/finsh/KConfig
```kconfig
menu "Command shell"

config RT_USING_FINSH
    bool "finsh shell"
    default y

if RT_USING_FINSH

config FINSH_USING_SYMTAB
    bool "Using symbol table for commands"
    default y

config FINSH_USING_DESCRIPTION
    bool "Keeping description in symbol table"
    default y

config FINSH_THREAD_STACK_SIZE
    int "The stack size for finsh thread"
    default 4096

config FINSH_USING_AUTH
    bool "shell support authentication"
    default n
   
config FINSH_DEFAULT_PASSWORD
    string "The default password for shell authentication"
    default "rtthread"

config FINSH_CMD_SIZE
    int "The size of command line"
    default 80

config FINSH_THREAD_STACK_SIZE
    int "The stack size of shell task"
    default 2048

config FINSH_THREAD_PRIORITY
    int "The priority level of shell task"
    default 20

config FINSH_USING_MSH
    bool "Using module shell"
    default y

config FINSH_USING_MSH_DEFAULT
    bool "Using module shell in default"
    default y

config FINSH_USING_MSH_ONLY
    bool "Only using module shell"
    default n

endif

endmenu
```
